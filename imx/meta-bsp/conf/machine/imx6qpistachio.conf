## imx/meta-bsp/conf/machine/imx6qpistachio.conf
```bitbake
#@TYPE: Machine
#@NAME: NXP i.MX Common rootfs machine for mfg tools
#@SOC: i.MX6 Quad Dual and Solo Rootfs

#@DESCRIPTION: Machine configuration for NXP i.MX 6 and 7  boards

# Consolidated rootfs to support i.MX 6 QuadPlus, Quad, Dual and Solo SoC
# Removing SoloLite and SoloX which will not be supported on this rootfs

include conf/machine/include/imx-base.inc
include conf/machine/include/tune-cortexa9.inc

MACHINEOVERRIDES =. "mx6:mx6q:"

# Add in DQ and DL device trees
KERNEL_DEVICETREE = "imx6q-pistachio.dtb"

UBOOT_MACHINE = "mx6_pistachio_defconfig"

# Ensure uEnv.txt will be available at rootfs time
do_rootfs[depends] += "u-boot-uenv:do_deploy"

UENV_FILENAME = "uEnv.txt"
BOOT_SCRIPTS = "${UENV_FILENAME}:uEnv.txt"

# build all vpu firmware packages into the image
MACHINE_FIRMWARE_append_mx6 = " firmware-imx-vpu-imx6q"

MACHINE_EXTRA_RRECOMMENDS += " \
  chromium libexif \
  openssh-sftp-server \
  bash hostapd dnsmasq haveged iptables \
  ethtool coreutils ppp iproute2 libsocketcan canutils util-linux \
  minicom iw wpa-supplicant i2c-tools \
  create-ap firmware-wg7833 uim \
  ppp curl networkmanager \
"

BOOT_SPACE = "16384"
SERIAL_CONSOLE = "115200 ttymxc3"
```
